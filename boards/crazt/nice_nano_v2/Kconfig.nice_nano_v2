## boards/crazt/nice_nano_v2/Kconfig.nice_nano_v2
```kconfig
# Copyright (c) 2026
# SPDX-License-Identifier: Apache-2.0

config BOARD_NICE_NANO_V2
	select SOC_NRF52840_QIAA
```

## boards/crazt/nice_nano_v2/board.yml
```yaml
# Copyright (c) 2026
# SPDX-License-Identifier: Apache-2.0

board:
  name: nice_nano_v2
  full_name: "nice!nano v2"
  vendor: crazt
  socs:
    - name: nrf52840
      variants:
        - name: dev
        - name: uf2
        - name: dev_st7789_ui
        - name: uf2_st7789_ui
```

## boards/crazt/nice_nano_v2/nice_nano_v2_nrf52840_uf2_defconfig
```kconfig
# Copyright (c) 2026
# SPDX-License-Identifier: Apache-2.0

CONFIG_ARM_MPU=y
CONFIG_HW_STACK_PROTECTION=y
CONFIG_GPIO=y
CONFIG_USB_DEVICE_REMOTE_WAKEUP=n

CONFIG_USB_DEVICE_MANUFACTURER="Crazt"
CONFIG_USB_DEVICE_PRODUCT="SlimeNRF Receiver nice!nano v2"

# Generate for Adafruit nRF52 UF2 bootloader flashing.
CONFIG_BUILD_OUTPUT_UF2=y
CONFIG_BUILD_OUTPUT_UF2_FAMILY_ID="0xADA52840"
CONFIG_FLASH_LOAD_OFFSET=0x1000
```

## boards/crazt/nice_nano_v2/nice_nano_v2_nrf52840_uf2_st7789_ui_defconfig
```kconfig
# Copyright (c) 2026
# SPDX-License-Identifier: Apache-2.0

CONFIG_ARM_MPU=y
CONFIG_HW_STACK_PROTECTION=y
CONFIG_GPIO=y
CONFIG_USB_DEVICE_REMOTE_WAKEUP=n

CONFIG_USB_DEVICE_MANUFACTURER="Crazt"
CONFIG_USB_DEVICE_PRODUCT="SlimeNRF Receiver nice!nano v2 ST7789"

# Generate for Adafruit nRF52 UF2 bootloader flashing.
CONFIG_BUILD_OUTPUT_UF2=y
CONFIG_BUILD_OUTPUT_UF2_FAMILY_ID="0xADA52840"
CONFIG_FLASH_LOAD_OFFSET=0x1000

CONFIG_SLIMENRF_DISPLAY_UI=y

CONFIG_SPI=y
CONFIG_PWM=y
CONFIG_DISPLAY=y
CONFIG_MIPI_DBI=y
CONFIG_MIPI_DBI_SPI=y
CONFIG_ST7789V=y
CONFIG_ST7789V_RGB565=y

CONFIG_INPUT=y
CONFIG_INPUT_GPIO_KEYS=y

CONFIG_LVGL=y
CONFIG_LV_COLOR_DEPTH_16=y
CONFIG_LV_COLOR_16_SWAP=y
CONFIG_LV_Z_BITS_PER_PIXEL=16
CONFIG_LV_Z_VDB_SIZE=10
CONFIG_LV_Z_BUFFER_ALLOC_STATIC=y
CONFIG_LV_Z_MEM_POOL_SIZE=16384
CONFIG_LV_Z_KEYPAD_INPUT=y
CONFIG_LV_Z_KEYPAD_INPUT_MSGQ_COUNT=8
CONFIG_LV_USE_LABEL=y
CONFIG_LV_FONT_MONTSERRAT_12=y
CONFIG_LV_FONT_MONTSERRAT_14=y

CONFIG_DISPLAY_LOG_LEVEL_ERR=y
CONFIG_MIPI_DBI_LOG_LEVEL_WRN=y
CONFIG_LV_USE_LOG=n
```

## boards/crazt/promicro/Kconfig.promicro
```kconfig
# Copyright (c) 2026
# SPDX-License-Identifier: Apache-2.0

config BOARD_PROMICRO
	select SOC_NRF52840_QIAA
```

## boards/crazt/promicro/board.yml
```yaml
# Copyright (c) 2026
# SPDX-License-Identifier: Apache-2.0

board:
  name: promicro
  full_name: ProMicro nRF52840
  vendor: crazt
  socs:
    - name: nrf52840
      variants:
        - name: dev
        - name: uf2
```

## boards/crazt/sk_cheesecake_nrf_p00/board.yml
```yaml
# Copyright (c) 2026
# SPDX-License-Identifier: Apache-2.0

board:
  name: sk_cheesecake_nrf_p00
  full_name: SK Cheesecake nRF P00
  vendor: crazt
  socs:
    - name: nrf52840
      variants:
        - name: dev
        - name: uf2
```

## boards/ebyte/ewt73_2g4m08s1c/Kconfig.ewt73_2g4m08s1c
```kconfig
# Copyright (c) 2026
# SPDX-License-Identifier: Apache-2.0

config BOARD_EWT73_2G4M08S1C
	select SOC_NRF52840_QIAA
```

## boards/ebyte/ewt73_2g4m08s1c/board.yml
```yaml
# Copyright (c) 2026
# SPDX-License-Identifier: Apache-2.0

board:
  name: ewt73_2g4m08s1c
  full_name: EWT73-2G4M08S1C
  vendor: ebyte
  socs:
    - name: nrf52840
      variants:
        - name: dev
        - name: uf2
```

## tests/remote_tcal_protocol/testcase.yaml
```yaml
tests:
  remote_tcal.protocol:
    platform_allow:
      - native_sim/native/64
    tags:
      - remote_tcal
      - protocol
```
